## app/dts/bindings/behaviors/macro_base.yaml
```yaml
# Copyright (c) 2022 The ZMK Contributors
# SPDX-License-Identifier: MIT

properties:
  bindings:
    type: phandle-array
    required: true
  wait-ms:
    type: int
    description: The default time to wait (in milliseconds) before triggering the next behavior in the macro bindings list.
  tap-ms:
    type: int
    description: The default time to wait (in milliseconds) between the press and release events on a tapped macro behavior binding
  pyuron-macro-slot:
    type: int
    description: |
      Pyuron live-editing slot index (0..5). When set and
      CONFIG_PYURON_MACRO_STUDIO_RPC is enabled, this macro's steps are read from
      the RAM/NVS mirror for that slot instead of the flashed bindings, so they
      can be edited at runtime from the desktop app.
```

## app/dts/bindings/behaviors/zmk,behavior-tap-dance.yaml
```yaml
# Copyright (c) 2022 The ZMK Contributors
# SPDX-License-Identifier: MIT

description: Tap Dance Behavior

compatible: "zmk,behavior-tap-dance"

include: zero_param.yaml

properties:
  bindings:
    type: phandle-array
    required: true
  tapping-term-ms:
    type: int
    default: 200
  pyuron-td-slot:
    type: int
    description: |
      Pyuron live-editing slot index (0..3). When set and
      CONFIG_PYURON_TAPDANCE_STUDIO_RPC is enabled, this tap-dance's steps,
      count and tapping term are read from the RAM/NVS mirror for that slot
      instead of the flashed values, so they can be edited at runtime.
```

## app/dts/bindings/input_processors/zmk,input-processor-pyuron-scroll-invert.yaml
```yaml
# Copyright (c) 2026 The ZMK Contributors
# SPDX-License-Identifier: MIT

description: >
  Pyuron scroll-direction inverter.
  Inverts the sign of INPUT_REL_WHEEL (vertical) and/or INPUT_REL_HWHEEL
  (horizontal) scroll events at runtime.  The invert_v / invert_h flags can
  be toggled live via the "pyuron_scroll" custom Studio RPC (requires
  CONFIG_PYURON_SCROLL_STUDIO_RPC=y) and are persisted to NVS.
  All other input codes pass through unchanged.

compatible: "zmk,input-processor-pyuron-scroll-invert"

include: ip_zero_param.yaml
```

## app/dts/bindings/input_processors/zmk,input-processor-pyuron-speed.yaml
```yaml
# Copyright (c) 2026 The ZMK Contributors
# SPDX-License-Identifier: MIT

description: >
  Pyuron trackball speed multiplier.
  Scales INPUT_REL_X / INPUT_REL_Y by a runtime percentage (100 = x1.0) with
  sub-step remainder accumulation, giving smooth cursor-speed control between
  the sensor's coarse 200-CPI hardware steps. Adjust live via the
  "pyuron_speed" custom Studio RPC (requires CONFIG_PYURON_SPEED_STUDIO_RPC=y);
  persisted to NVS. All other input codes pass through unchanged.

compatible: "zmk,input-processor-pyuron-speed"

include: ip_zero_param.yaml
```

## app/dts/bindings/zmk,combos.yaml
```yaml
# Copyright (c) 2020, The ZMK Contributors
# SPDX-License-Identifier: MIT

description: Combos container

compatible: "zmk,combos"

child-binding:
  description: "A combo"

  properties:
    bindings:
      type: phandle-array
      required: true
    key-positions:
      type: array
      required: true
    timeout-ms:
      type: int
      default: 50
    require-prior-idle-ms:
      type: int
      default: -1
    slow-release:
      type: boolean
    layers:
      type: array
    pyuron-combo-slot:
      type: int
      description: |
        Pyuron live-editing slot index (0..5). When set and
        CONFIG_PYURON_COMBO_STUDIO_RPC is enabled, this combo's key positions,
        fire behavior, timeout and layer mask are taken from the RAM/NVS mirror
        for that slot (and start disabled until configured), so they can be
        edited at runtime from the desktop app.
```

## app/src/pointing/Kconfig
```kconfig
# Copyright (c) 2024 The ZMK Contributors
# SPDX-License-Identifier: MIT

menu "Pointing Options"

# Deprecated old config, kept for backwards compat
config ZMK_MOUSE
    bool "(Deprecated) Mouse Support"

config ZMK_POINTING
    bool "Pointing Device Support"
    default y if ZMK_MOUSE
    select INPUT
    select INPUT_THREAD_PRIORITY_OVERRIDE

if ZMK_POINTING

# Needed for anyone using gpio-keys for things like soft-off setup.
config INPUT_GPIO_KEYS
    default n

config INPUT_THREAD_STACK_SIZE
    default 1024 if ZMK_SPLIT && !ZMK_SPLIT_ROLE_CENTRAL

if !ZMK_SPLIT || ZMK_SPLIT_ROLE_CENTRAL

config ZMK_POINTING_SMOOTH_SCROLLING
    bool "Smooth Scrolling"
    help
      Enable smooth scrolling, with hosts that support HID Resolution Multipliers

config ZMK_INPUT_LISTENER
    bool "Input listener for processing input events in the system"
    default y
    depends on DT_HAS_ZMK_INPUT_LISTENER_ENABLED


config ZMK_INPUT_PROCESSOR_TEMP_LAYER
    bool "Temporary Layer Input Processor"
    default y
    depends on DT_HAS_ZMK_INPUT_PROCESSOR_TEMP_LAYER_ENABLED

config ZMK_INPUT_PROCESSOR_TEMP_LAYER_MAX_ACTION_EVENTS
    int "Temporary Layer Input Processor Max Action Events"
    default 4
    depends on ZMK_INPUT_PROCESSOR_TEMP_LAYER

config ZMK_INPUT_PROCESSOR_TEMP_LAYER_STUCK_RECOVERY
    bool "Temporary Layer stuck recovery watchdog"
    depends on ZMK_INPUT_PROCESSOR_TEMP_LAYER
    help
      Add a delayed recovery check for temporary layers that remain active far
      longer than their normal dwell timeout. This is intended to recover from
      a lost/deferred deactivate work item without changing normal layer use.

config ZMK_INPUT_PROCESSOR_TEMP_LAYER_STUCK_TIMEOUT_MS
    int "Temporary Layer stuck recovery timeout in milliseconds"
    default 30000
    depends on ZMK_INPUT_PROCESSOR_TEMP_LAYER_STUCK_RECOVERY
    help
      If the temporary layer is still active after this much time without
      renewed pointing/excluded-key activity, force a layer deactivation.

config ZMK_INPUT_PROCESSOR_TEMP_LAYER_STUCK_REBOOT
    bool "Reboot after temporary layer stuck recovery"
    depends on ZMK_INPUT_PROCESSOR_TEMP_LAYER_STUCK_RECOVERY
    select REBOOT
    help
      Reboot the central MCU after the forced layer deactivation. Use this only
      when the real-world failure is known to recover from a central-side power
      cycle or reboot.

config ZMK_INPUT_PROCESSOR_TEMP_LAYER_STUDIO_RPC
    bool "AML Studio RPC (live config via ZMK Studio)"
    depends on ZMK_INPUT_PROCESSOR_TEMP_LAYER
    select SETTINGS
    help
      Expose AutoMouse Layer config (deactivation timeout, prior-idle guard,
      excluded key positions) via a custom Studio RPC subsystem "pyuron_aml".
      Requires the ZMK fork with custom-studio-protocol support.
      Changes are persisted to NVS and survive reboot.

# ---- AML config seed (version-gated) -------------------------------------
# ソース側に「シード値＋バージョン番号」を持たせ、起動時に
#   ソースの SEED_VERSION > NVS に記録済みの取り込み済みバージョン
# のときだけシード値を NVS に書き込む。同じか古ければ何もしない
# (ライブ調整値を温存)。default 0 = シードしない(現状の NVS を一切触らない)。
if ZMK_INPUT_PROCESSOR_TEMP_LAYER_STUDIO_RPC

config PYURON_AML_SEED_VERSION
    int "AML seed version (0 = never seed)"
    default 0
    help
      ソースが持つ AML シード設定のバージョン番号。起動時に NVS に記録された
      取り込み済みバージョンより大きいときだけ、下記の SEED_* 値を NVS へ
      取り込む(1度だけ)。0 のままならシードは走らず、既存の NVS 値
      (ライブ調整値)は一切変更されない(非破壊・出荷時デフォルト)。
      新しいシード値を反映させたいときだけ、この番号を 1 ずつ増やす。

config PYURON_AML_SEED_DEACTIVATION_MS
    int "AML seed: deactivation_ms (-1 = leave unchanged)"
    default -1
    help
      シード時に書き込む AML 滞在時間(ms)。-1(既定)は「未指定」とみなし、その
      項目は据え置く(既存値/param2 由来の既定を温存)。0 以上は明示値として焼く。

config PYURON_AML_SEED_PRIOR_IDLE_MS
    int "AML seed: prior_idle_ms (-1 = leave unchanged)"
    default -1
    help
      シード時に書き込む AML 発火ガード(ms)。-1(既定)は「未指定」=据え置き。
      0 は有効値(ガードなし=いつでも入る)として焼けるよう、印は -1 を使う。

config PYURON_AML_SEED_EXTEND_MS
    int "AML seed: extend_ms (-1 = leave unchanged)"
    default -1
    help
      シード時に書き込む除外キー延長(ms)。-1(既定)は「未指定」=据え置き。
      0 は有効値(延長しない)として焼けるよう、印は -1 を使う。

config PYURON_AML_SEED_EXCLUDED
    string "AML seed: excluded positions (space-separated, empty = leave unchanged)"
    default ""
    help
      シード時に書き込む除外キー位置の配列。"12 34 56" のように空白区切りで
      位置番号を並べる。空文字は「未指定」とみなし、除外リストは据え置く。
      AML_MAX_EXCLUDED(=16) を超える分・範囲外は無視する。

endif # ZMK_INPUT_PROCESSOR_TEMP_LAYER_STUDIO_RPC

config ZMK_INPUT_PROCESSOR_PYURON_SCROLL_INVERT
    bool "Pyuron scroll-direction inverter input processor"
    default y
    depends on DT_HAS_ZMK_INPUT_PROCESSOR_PYURON_SCROLL_INVERT_ENABLED

config PYURON_SCROLL_STUDIO_RPC
    bool "Pyuron scroll-invert Studio RPC (live toggle via ZMK Studio)"
    depends on ZMK_INPUT_PROCESSOR_PYURON_SCROLL_INVERT
    select SETTINGS
    help
      Expose scroll-direction inversion flags (invert_v / invert_h) via a
      custom Studio RPC subsystem "pyuron_scroll".  Lets the ZMK Studio app
      toggle Win/Mac natural-scroll direction at runtime without reflashing.
      Requires the ZMK fork with custom-studio-protocol support.
      Changes are persisted to NVS and survive reboot.

config ZMK_INPUT_PROCESSOR_PYURON_SPEED
    bool "Pyuron trackball speed-multiplier input processor"
    default y
    depends on DT_HAS_ZMK_INPUT_PROCESSOR_PYURON_SPEED_ENABLED

config PYURON_SPEED_STUDIO_RPC
    bool "Pyuron trackball speed Studio RPC (live % adjust via ZMK Studio)"
    depends on ZMK_INPUT_PROCESSOR_PYURON_SPEED
    select SETTINGS
    help
      Expose the trackball cursor speed multiplier (percent, 100 = x1.0) via a
      custom Studio RPC subsystem "pyuron_speed".  Gives smooth cursor-speed
      control between the sensor's coarse 200-CPI hardware steps, without
      reflashing.  Changes are persisted to NVS and survive reboot.

endif

config ZMK_INPUT_PROCESSOR_TRANSFORM
    bool "Transform Input Processor"
    default y
    depends on DT_HAS_ZMK_INPUT_PROCESSOR_TRANSFORM_ENABLED

config ZMK_INPUT_PROCESSOR_SCALER
    bool "Scaling Input Processor"
    default y
    depends on DT_HAS_ZMK_INPUT_PROCESSOR_SCALER_ENABLED

config ZMK_INPUT_PROCESSOR_CODE_MAPPER
    bool "Code Mapper Input Processor"
    default y
    depends on DT_HAS_ZMK_INPUT_PROCESSOR_CODE_MAPPER_ENABLED

config ZMK_INPUT_PROCESSOR_BEHAVIORS
    bool "Behaviors Input Processor"
    default y
    depends on DT_HAS_ZMK_INPUT_PROCESSOR_BEHAVIORS_ENABLED

config ZMK_INPUT_SPLIT
    bool "Split input support"
    default y
    depends on DT_HAS_ZMK_INPUT_SPLIT_ENABLED && ZMK_SPLIT

if ZMK_INPUT_SPLIT

config ZMK_INPUT_SPLIT_INIT_PRIORITY
    int "Input Split initialization priority"
    default INPUT_INIT_PRIORITY


config ZMK_INPUT_SPLIT_MAX_TRACKED_KEYS
    int "Input Split max tracked keys to release on peripheral disconnect"
    default 5

endif # ZMK_INPUT_SPLIT

endif # ZMK_POINTING

endmenu # Mouse Options
```

## app/src/split/bluetooth/Kconfig
```kconfig
# Copyright (c) 2022 The ZMK Contributors
# SPDX-License-Identifier: MIT

if ZMK_SPLIT && ZMK_SPLIT_BLE

menu "BLE Transport"

config ZMK_SPLIT_BLE_PRIORITY
    int "BLE transport priority"
    help
        Lower number priorities transports are favored over higher numbers.

# Added for backwards compatibility. New shields / board should set `ZMK_SPLIT_ROLE_CENTRAL` only.
config ZMK_SPLIT_BLE_ROLE_CENTRAL
    bool
    select ZMK_SPLIT_ROLE_CENTRAL

config ZMK_SPLIT_ROLE_CENTRAL
    select BT_CENTRAL
    select BT_GATT_CLIENT
    select BT_GATT_AUTO_DISCOVER_CCC
    select BT_SCAN_WITH_IDENTITY

# Bump this value needed for concurrent GATT discovery of splits
config BT_ATT_TX_COUNT
    default 10 if ZMK_SPLIT_ROLE_CENTRAL

if ZMK_SPLIT_ROLE_CENTRAL

config ZMK_SPLIT_BLE_CENTRAL_PERIPHERALS
    int "Number of peripherals that will connect to the central."

menuconfig ZMK_SPLIT_BLE_CENTRAL_BATTERY_LEVEL_FETCHING
    bool "Fetch Peripheral Battery Level Info"
    help
      Adds internal support for fetching the battery levels from peripherals
      and generating events in the ZMK eventing system.

if ZMK_SPLIT_BLE_CENTRAL_BATTERY_LEVEL_FETCHING

config ZMK_SPLIT_BLE_CENTRAL_BATTERY_LEVEL_QUEUE_SIZE
    int "Max number of battery level events to queue when received from peripherals"
    default ZMK_SPLIT_BLE_CENTRAL_PERIPHERALS

config ZMK_SPLIT_BLE_CENTRAL_BATTERY_LEVEL_PROXY
    bool "Proxy Peripheral Battery Level Info"
    help
      Adds support for reporting the battery levels of connected split
      peripherals through an additional Battery Level service.

endif

config ZMK_SPLIT_BLE_CENTRAL_POSITION_QUEUE_SIZE
    int "Max number of key position state events to queue when received from peripherals"
    default 5

config ZMK_SPLIT_BLE_CENTRAL_SPLIT_RUN_STACK_SIZE
    int "BLE split central write thread stack size"
    default 512

config ZMK_SPLIT_BLE_CENTRAL_SPLIT_RUN_QUEUE_SIZE
    int "Max number of behavior run events to queue to send to the peripheral(s)"
    default 5

config ZMK_SPLIT_BLE_PREF_INT
    int "Connection interval to use for split central/peripheral connection"
    default 6

config ZMK_SPLIT_BLE_PREF_LATENCY
    int "Latency to use for split central/peripheral connection"
    default 30

config ZMK_SPLIT_BLE_PREF_TIMEOUT
    int "Supervision timeout to use for split central/peripheral connection"
    default 400

config ZMK_SPLIT_BLE_CENTRAL_CPI_FORWARD
    bool "Central: forward CPI changes to peripheral trackball sensors"
    default n
    help
      When enabled the central discovers the CPI-forward write characteristic
      on each peripheral and exposes zmk_split_bt_cpi_forward() so modules
      (e.g. zmk-pmw3610-driver) can propagate live CPI changes to sensors
      that physically live on the peripheral half.

endif # ZMK_SPLIT_ROLE_CENTRAL

if !ZMK_SPLIT_ROLE_CENTRAL

config ZMK_SPLIT_PERIPHERAL_CPI_FORWARD
    bool "Peripheral: accept CPI-forward write commands from central"
    default n
    help
      When enabled the peripheral exposes a write-without-response GATT
      characteristic (ZMK_SPLIT_BT_CPI_FORWARD_UUID) so the central can
      change the CPI of a sensor that lives here.  Modules must provide a
      strong override of zmk_split_peripheral_cpi_apply() to act on the
      write; the default weak implementation returns -ENOTSUP.

config ZMK_SPLIT_BLE_PERIPHERAL_STACK_SIZE
    int "BLE split peripheral notify thread stack size"
    default 756

config ZMK_SPLIT_BLE_PERIPHERAL_PRIORITY
    int "BLE split peripheral notify thread priority"
    default 5

config ZMK_SPLIT_BLE_PERIPHERAL_POSITION_QUEUE_SIZE
    int "Max number of key position state events to queue to send to the central"
    default 10

config BT_MAX_PAIRED
    default 1

config BT_MAX_CONN
    default 1

# Allow central to specify connection parameters.
config BT_GAP_AUTO_UPDATE_CONN_PARAMS
    default n

endif # !ZMK_SPLIT_ROLE_CENTRAL

endmenu

endif # ZMK_SPLIT_BLE
```
